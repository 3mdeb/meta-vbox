## conf/layer.conf
```bitbake
# We have a conf and classes directory, add to BBPATH
BBPATH .= ":${LAYERDIR}"

# We have recipes-* directories, add to BBFILES
BBFILES += "${LAYERDIR}/recipes-*/*/*.bb ${LAYERDIR}/recipes-*/*/*.bbappend"

BBFILE_COLLECTIONS += "vbox"
BBFILE_PATTERN_vbox = "^${LAYERDIR}/"
BBFILE_PRIORITY_vbox = "1"

# This should only be incremented on significant changes that will
# cause compatibility issues with other layers
LAYERVERSION_vbox = "1"

LAYERDEPENDS_vbox = " \
    core \
    openembedded-layer \
    "

LAYERSERIES_COMPAT_vbox = "dunfell master"
```

## conf/machine/vbox.conf
```bitbake
#@TYPE: Machine
#@NAME: VirtualBox Machine
#@DESCRIPTION: Machine configuration VirtualBox guest

require conf/machine/qemux86-64.conf

MACHINE_ESSENTIAL_EXTRA_RDEPENDS += "vboxguestdrivers"
MACHINE_EXTRA_RRECOMMENDS += "kernel-modules"

KMACHINE_vbox = "qemux86-64"
```
